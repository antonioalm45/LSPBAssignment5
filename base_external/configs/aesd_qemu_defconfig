## base_external/configs/aesd_qemu_defconfig
```kconfig
BR2_aarch64=y
BR2_TOOLCHAIN_EXTERNAL=y
BR2_TARGET_GENERIC_ROOT_PASSWD="root"
BR2_SYSTEM_DHCP="eth0"
BR2_ROOTFS_OVERLAY="../base_external/rootfs_overlay"
BR2_LINUX_KERNEL=y
BR2_LINUX_KERNEL_USE_CUSTOM_CONFIG=y
BR2_LINUX_KERNEL_CUSTOM_CONFIG_FILE="$(LINUX_DIR)/arch/arm64/configs/defconfig"
BR2_LINUX_KERNEL_IMAGE_TARGET_CUSTOM=y
BR2_LINUX_KERNEL_IMAGE_TARGET_NAME="Image"
BR2_PACKAGE_HAVEGED=y
BR2_PACKAGE_DROPBEAR=y
BR2_PACKAGE_DROPBEAR_DISABLE_REVERSEDNS=y
BR2_PACKAGE_OPENSSH=y
BR2_TARGET_ROOTFS_EXT2=y
BR2_TARGET_ROOTFS_EXT2_4=y
BR2_TARGET_ROOTFS_EXT2_SIZE="200M"
BR2_PACKAGE_LDD=y
BR2_PACKAGE_AESD_ASSIGNMENTS=y
```

## base_external/package/aesdchar/Config.in
```kconfig
config BR2_PACKAGE_AESDCHAR
    bool "aesdchar"
    depends on BR2_LINUX_KERNEL
    help
      Asignación 8 del curso.
```

## base_external/package/misc-modules/Config.in
```kconfig
config BR2_PACKAGE_MISC_MODULES
    bool "misc-modules"
    depends on BR2_LINUX_KERNEL
    help
      Asignación 7 del curso.
```

## base_external/package/scull/Config.in
```kconfig
config BR2_PACKAGE_SCULL
    bool "scull"
    depends on BR2_LINUX_KERNEL
    help
      Asignación 7 del curso.
```
